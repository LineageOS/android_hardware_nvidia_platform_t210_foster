#include "tegra210-loki-e-p2530-0031-e00-00.dts"
#include "foster-platforms/tegra210-loki-e-emc-a01.dtsi"

/ {
	nvidia,dtsfilename = __FILE__;

	i2c@7000c400 {
		ads1015@4a {
			ti,enable-continuous-mode;
			ti,continuous-channel-number = <4>;
			ti,maximum-retries = <6>;
			ti,adc-valid-threshold-ranges= <(-100)     30
							40    78
							382   418
							220   242
							122   136
							2000  2047>;
		};
	};
};
